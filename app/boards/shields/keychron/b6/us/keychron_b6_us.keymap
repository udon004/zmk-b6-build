/ {
    keymap_0: keymap {
        compatible = "zmk,keymap";

        layout = <
            0x00 0x01 0x02 0x03 0x04 0x05 0x06 0x07 0x08 0x09
            0x0A 0x0B 0x0C 0x0D 0x0E 0x0F 0x10 0x11 0x12 0x13
            0x14 0x15 0x16 0x17 0x18 0x19 0x1A 0x1B 0x1C 0x1D
            0x1E 0x1F 0x20 0x21 0x22 0x23 0x24 0x25 0x26 0x27
            0x28 0x29 0x2A 0x2B 0x2C 0x2D 0x2E 0x2F 0x30 0x31
            0x32 0x33 0x34 0x35 0x36 0x37 0x38 0x39 0x3A 0x3B
            0x3C 0x3D 0x3E 0x3F 0x40 0x41 0x42 0x43 0x44 0x45
            0x46 0x47 0x48 0x49 0x4A 0x4B 0x4C 0x4D 0x4E 0x4F
            0x50 0x51 0x52 0x53 0x54 0x55 0x56 0x57 0x58 0x59
            0x5A 0x5B
        >;

        bindings = <
            &kp ESC &kp 1 &kp 2 &kp 3 &kp 4 &kp 5 &kp 6 &kp 7 &kp 8
            &kp 9 &kp 0 &kp MINUS &kp EQUAL &kp BSPC &kp TAB &kp Q &kp W &kp E
            &kp R &kp T &kp Y &kp U &kp I &kp O &kp P &kp LBKT &kp RBKT &kp BSLH
            &kp CAPS &kp A &kp S &kp D &kp F &kp G &kp H &kp J &kp K &kp L
            &kp SEMI &kp SQT &kp ENTER &kp LSHIFT &kp Z &kp X &kp C &kp V &kp B
            &kp N &kp M &kp COMMA &kp DOT &kp FSLH &kp RSHIFT &kp LCTRL &kp LGUI &kp LALT
            &kp SPACE &kp SPACE &kp SPACE &kp SPACE &kp RALT &kp RGUI &kp MENU &kp RCTRL &kp F1
            &kp F2 &kp F3 &kp F4 &kp F5 &kp F6 &kp F7 &kp F8 &kp F9 &kp F10
            &kp F11 &kp F12
        >;
    };
};
